dummy_spi: dummy_spimaster {
    compatible = "dummy-spi-master";
    status = "disabled";
	#address-cells = <1>;
	#size-cells = <0>;
};

&dummy_spi {
	//pinctrl-names = "default";
	//pinctrl-0 = <&dummy_spi_pins>;
	status = "okay";
	dummy_spidev@0 {
		status = "okay";
		compatible = "dummy-spi-device";
		reg = <0>;
		spi-max-frequency = <32000000>;
		spi-cpol;
		spi-cpha;
	};
};
