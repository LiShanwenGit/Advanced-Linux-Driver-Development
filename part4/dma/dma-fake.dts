spi0: spi@1c68000 {
        compatible = "allwinner,sun50i-h616-spi";
        reg = <0x01c68000 0x1000>;
        dmas = <&dma 22>, <&dma 22>;
        dma-names = "rx", "tx";
        status = "okay";
        #address-cells = <1>;
        #size-cells = <0>;
};
